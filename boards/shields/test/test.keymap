#include <behaviors.dtsi>
#include <dt-bindings/zmk/keys.h>

/ {
  keymap {
    compatible = "zmk,keymap";
    base_layer {
          bindings = <&kp ESCAPE &kp Q &kp W &kp E &kp R &kp T &kp Y &kp U &kp I &kp O &kp P &kp BACKSPACE &kp TAB &kp A &kp S &kp D &kp F &kp G &kp H &kp J &kp K &kp L &kp ENTER &kp LEFT_SHIFT &kp Z &kp X &kp C &kp V &kp B &kp N &kp M &kp PRINTSCREEN &kp CAPSLOCK &kp DELETE &kp LEFT_CONTROL &kp LEFT_GUI &kp LEFT_ALT &kp SPACE &mo 2 &mo 1
          >;
        };

    };
  };
