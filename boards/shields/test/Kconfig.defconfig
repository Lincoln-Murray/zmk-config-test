## boards/shields/test/Kconfig.defconfig
```kconfig
# Required files for ZMK to recognize the shield

if TEST

# Name must be less than 16 characters long!
config ZMK_KEYBOARD_NAME
    default "test"

endif
```
